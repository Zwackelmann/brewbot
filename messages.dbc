VERSION "1.0"

NS_ :

BS_:

BU_: MASTER HEAT_PLATE

BO_ 2147549088 HEAT_PLATE: 8 MASTER
 SG_ RELAY_STATE : 0|8@1+ (1,0) [0|255] "" HEAT_PLATE
