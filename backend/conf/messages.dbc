VERSION "1.0"

NS_ :

BS_:

BU_: MASTER_NODE HEAT_PLATE_NODE MOTOR_NODE TEMP_NODE

BO_ 2147549088 HEAT_PLATE_CMD: 8 MASTER_NODE
 SG_ RELAY_STATE : 0|1@1+ (1,0) [0|1] "" HEAT_PLATE_NODE

BO_ 2147549089 HEAT_PLATE_STATE: 8 HEAT_PLATE_NODE
 SG_ RELAY_STATE : 0|1@1+ (1,0) [0|1] "" MASTER_NODE

BO_ 2147549104 MOTOR_CMD: 8 MASTER_NODE
  SG_ RELAY_STATE : 0|1@1+ (1,0) [0|1] "" MOTOR_NODE

BO_ 2147549105 MOTOR_STATE: 8 MOTOR_NODE
  SG_ RELAY_STATE : 0|1@1+ (1,0) [0|1] "" MASTER_NODE

BO_ 2147549121 TEMP_STATE: 8 TEMP_NODE
  SG_ TEMP_C : 0|16@1- (0.01,0) [-327.68|327.67] "C" MASTER_NODE
  SG_ TEMP_V : 16|16@1+ (0.001,0) [0|65.535] "V" MASTER_NODE
