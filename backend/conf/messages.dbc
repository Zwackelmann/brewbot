VERSION "1.0"

NS_ :

BS_:

BU_: MASTER HEAT_PLATE MOTOR TEMP

BO_ 2147549088 HEAT_PLATE: 8 MASTER
 SG_ RELAY_STATE : 0|1@1+ (1,0) [0|1] "" HEAT_PLATE

BO_ 2147549089 MOTOR: 8 MASTER
  SG_ RELAY_STATE : 0|1@1+ (1,0) [0|1] "" MOTOR

BO_ 2147549104 TEMP: 8 TEMP
  SG_ TEMP_VOLTAGE : 0|10@1+ (1,0) [0|1023] "V" MASTER
